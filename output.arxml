AUTOSAR XML (schema 00046)
package /AutosarConfigurator
  module config CanNm: implementation-config-variant=VARIANT-POST-BUILD, module-description=CanNm
    CanNmGlobalConfig
    CanNmChannelConfig
      CanNmRxPdu
      CanNmUserDataTxPdu
    CanNmPnInfo
      CanNmPnFilterMaskByte
