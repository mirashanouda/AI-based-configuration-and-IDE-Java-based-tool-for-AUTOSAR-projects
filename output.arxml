AUTOSAR XML (schema 00046)
package /AutosarConfigurator
  module config CanNm: implementation-config-variant=VARIANT-POST-BUILD, module-description=CanNm
    CanNmGlobalConfig:
      CanNmBusLoadReductionEnabled = (unset)
      CanNmBusSynchronizationEnabled = (unset)
      CanNmComControlEnabled = (unset)
      CanNmComUserDataSupport = (unset)
      CanNmCoordinatorSyncSupport = (unset)
      CanNmDevErrorDetect = (unset)
      CanNmGlobalPnSupport = (unset)
      CanNmImmediateRestartEnabled = (unset)
      CanNmImmediateTxconfEnabled = (unset)
      CanNmPassiveModeEnabled = (unset)
      CanNmPduRxIndicationEnabled = (unset)
      CanNmRemoteSleepIndEnabled = (unset)
      CanNmStateChangeIndEnabled = (unset)
      CanNmUserDataEnabled = (unset)
      CanNmVersionInfoApi = (unset)
      CanNmMainFunctionPeriod = (unset)
    6 x CanNmChannelConfig, all with CanNmImmediateNmTransmissions=(unset), CanNmNodeId=(unset), CanNmBusLoadReductionActive=(unset), CanNmCarWakeUpRxEnabled=(unset), CanNmNodeDetectionEnabled=(unset), CanNmNodeIdEnabled=(unset), CanNmRepeatMsgIndEnabled=(unset), CanNmMsgCycleOffset=(unset), CanNmMsgCycleTime=(unset), CanNmMsgReducedTime=(unset), CanNmRepeatMessageTime=(unset), CanNmTimeoutTime=(unset), CanNmWaitBusSleepTime=(unset), CanNmPduCbvPosition=(unset), CanNmPduNidPosition=(unset):
      CanNmChannelConfig
        6 x CanNmRxPdu, all with CanNmRxPduId=(unset):
          CanNmRxPdu
          CanNmRxPdu
          CanNmRxPdu
          CanNmRxPdu
          CanNmRxPdu
          CanNmRxPdu
      CanNmChannelConfig
        6 x CanNmRxPdu, all with CanNmRxPduId=(unset):
          CanNmRxPdu
          CanNmRxPdu
          CanNmRxPdu
          CanNmRxPdu
          CanNmRxPdu
          CanNmRxPdu
      CanNmChannelConfig
        6 x CanNmRxPdu, all with CanNmRxPduId=(unset):
          CanNmRxPdu
          CanNmRxPdu
          CanNmRxPdu
          CanNmRxPdu
          CanNmRxPdu
          CanNmRxPdu
      CanNmChannelConfig
        6 x CanNmRxPdu, all with CanNmRxPduId=(unset):
          CanNmRxPdu
          CanNmRxPdu
          CanNmRxPdu
          CanNmRxPdu
          CanNmRxPdu
          CanNmRxPdu
      CanNmChannelConfig
        6 x CanNmRxPdu, all with CanNmRxPduId=(unset):
          CanNmRxPdu
          CanNmRxPdu
          CanNmRxPdu
          CanNmRxPdu
          CanNmRxPdu
          CanNmRxPdu
      CanNmChannelConfig
        6 x CanNmRxPdu, all with CanNmRxPduId=(unset):
          CanNmRxPdu
          CanNmRxPdu
          CanNmRxPdu
          CanNmRxPdu
          CanNmRxPdu
          CanNmRxPdu
    CanNmGlobalConfig:
      CanNmBusLoadReductionEnabled = (unset)
      CanNmBusSynchronizationEnabled = (unset)
      CanNmComControlEnabled = (unset)
      CanNmComUserDataSupport = (unset)
      CanNmCoordinatorSyncSupport = (unset)
      CanNmDevErrorDetect = (unset)
      CanNmGlobalPnSupport = (unset)
      CanNmImmediateRestartEnabled = (unset)
      CanNmImmediateTxconfEnabled = (unset)
      CanNmPassiveModeEnabled = (unset)
      CanNmPduRxIndicationEnabled = (unset)
      CanNmRemoteSleepIndEnabled = (unset)
      CanNmStateChangeIndEnabled = (unset)
      CanNmUserDataEnabled = (unset)
      CanNmVersionInfoApi = (unset)
      CanNmMainFunctionPeriod = (unset)
    6 x CanNmChannelConfig, all with CanNmImmediateNmTransmissions=(unset), CanNmNodeId=(unset), CanNmBusLoadReductionActive=(unset), CanNmCarWakeUpRxEnabled=(unset), CanNmNodeDetectionEnabled=(unset), CanNmNodeIdEnabled=(unset), CanNmRepeatMsgIndEnabled=(unset), CanNmMsgCycleOffset=(unset), CanNmMsgCycleTime=(unset), CanNmMsgReducedTime=(unset), CanNmRepeatMessageTime=(unset), CanNmTimeoutTime=(unset), CanNmWaitBusSleepTime=(unset), CanNmPduCbvPosition=(unset), CanNmPduNidPosition=(unset):
      CanNmChannelConfig
        6 x CanNmRxPdu, all with CanNmRxPduId=(unset):
          CanNmRxPdu
          CanNmRxPdu
          CanNmRxPdu
          CanNmRxPdu
          CanNmRxPdu
          CanNmRxPdu
      CanNmChannelConfig
        6 x CanNmRxPdu, all with CanNmRxPduId=(unset):
          CanNmRxPdu
          CanNmRxPdu
          CanNmRxPdu
          CanNmRxPdu
          CanNmRxPdu
          CanNmRxPdu
      CanNmChannelConfig
        6 x CanNmRxPdu, all with CanNmRxPduId=(unset):
          CanNmRxPdu
          CanNmRxPdu
          CanNmRxPdu
          CanNmRxPdu
          CanNmRxPdu
          CanNmRxPdu
      CanNmChannelConfig
        6 x CanNmRxPdu, all with CanNmRxPduId=(unset):
          CanNmRxPdu
          CanNmRxPdu
          CanNmRxPdu
          CanNmRxPdu
          CanNmRxPdu
          CanNmRxPdu
      CanNmChannelConfig
        6 x CanNmRxPdu, all with CanNmRxPduId=(unset):
          CanNmRxPdu
          CanNmRxPdu
          CanNmRxPdu
          CanNmRxPdu
          CanNmRxPdu
          CanNmRxPdu
      CanNmChannelConfig
        6 x CanNmRxPdu, all with CanNmRxPduId=(unset):
          CanNmRxPdu
          CanNmRxPdu
          CanNmRxPdu
          CanNmRxPdu
          CanNmRxPdu
          CanNmRxPdu
    CanNmGlobalConfig:
      CanNmBusLoadReductionEnabled = (unset)
      CanNmBusSynchronizationEnabled = (unset)
      CanNmComControlEnabled = (unset)
      CanNmComUserDataSupport = (unset)
      CanNmCoordinatorSyncSupport = (unset)
      CanNmDevErrorDetect = (unset)
      CanNmGlobalPnSupport = (unset)
      CanNmImmediateRestartEnabled = (unset)
      CanNmImmediateTxconfEnabled = (unset)
      CanNmPassiveModeEnabled = (unset)
      CanNmPduRxIndicationEnabled = (unset)
      CanNmRemoteSleepIndEnabled = (unset)
      CanNmStateChangeIndEnabled = (unset)
      CanNmUserDataEnabled = (unset)
      CanNmVersionInfoApi = (unset)
      CanNmMainFunctionPeriod = (unset)
    6 x CanNmChannelConfig, all with CanNmImmediateNmTransmissions=(unset), CanNmNodeId=(unset), CanNmBusLoadReductionActive=(unset), CanNmCarWakeUpRxEnabled=(unset), CanNmNodeDetectionEnabled=(unset), CanNmNodeIdEnabled=(unset), CanNmRepeatMsgIndEnabled=(unset), CanNmMsgCycleOffset=(unset), CanNmMsgCycleTime=(unset), CanNmMsgReducedTime=(unset), CanNmRepeatMessageTime=(unset), CanNmTimeoutTime=(unset), CanNmWaitBusSleepTime=(unset), CanNmPduCbvPosition=(unset), CanNmPduNidPosition=(unset):
      CanNmChannelConfig
        6 x CanNmRxPdu, all with CanNmRxPduId=(unset):
          CanNmRxPdu
          CanNmRxPdu
          CanNmRxPdu
          CanNmRxPdu
          CanNmRxPdu
          CanNmRxPdu
      CanNmChannelConfig
        6 x CanNmRxPdu, all with CanNmRxPduId=(unset):
          CanNmRxPdu
          CanNmRxPdu
          CanNmRxPdu
          CanNmRxPdu
          CanNmRxPdu
          CanNmRxPdu
      CanNmChannelConfig
        6 x CanNmRxPdu, all with CanNmRxPduId=(unset):
          CanNmRxPdu
          CanNmRxPdu
          CanNmRxPdu
          CanNmRxPdu
          CanNmRxPdu
          CanNmRxPdu
      CanNmChannelConfig
        6 x CanNmRxPdu, all with CanNmRxPduId=(unset):
          CanNmRxPdu
          CanNmRxPdu
          CanNmRxPdu
          CanNmRxPdu
          CanNmRxPdu
          CanNmRxPdu
      CanNmChannelConfig
        6 x CanNmRxPdu, all with CanNmRxPduId=(unset):
          CanNmRxPdu
          CanNmRxPdu
          CanNmRxPdu
          CanNmRxPdu
          CanNmRxPdu
          CanNmRxPdu
      CanNmChannelConfig
        6 x CanNmRxPdu, all with CanNmRxPduId=(unset):
          CanNmRxPdu
          CanNmRxPdu
          CanNmRxPdu
          CanNmRxPdu
          CanNmRxPdu
          CanNmRxPdu
    CanNmGlobalConfig:
      CanNmBusLoadReductionEnabled = (unset)
      CanNmBusSynchronizationEnabled = (unset)
      CanNmComControlEnabled = (unset)
      CanNmComUserDataSupport = (unset)
      CanNmCoordinatorSyncSupport = (unset)
      CanNmDevErrorDetect = (unset)
      CanNmGlobalPnSupport = (unset)
      CanNmImmediateRestartEnabled = (unset)
      CanNmImmediateTxconfEnabled = (unset)
      CanNmPassiveModeEnabled = (unset)
      CanNmPduRxIndicationEnabled = (unset)
      CanNmRemoteSleepIndEnabled = (unset)
      CanNmStateChangeIndEnabled = (unset)
      CanNmUserDataEnabled = (unset)
      CanNmVersionInfoApi = (unset)
      CanNmMainFunctionPeriod = (unset)
    6 x CanNmChannelConfig, all with CanNmImmediateNmTransmissions=(unset), CanNmNodeId=(unset), CanNmBusLoadReductionActive=(unset), CanNmCarWakeUpRxEnabled=(unset), CanNmNodeDetectionEnabled=(unset), CanNmNodeIdEnabled=(unset), CanNmRepeatMsgIndEnabled=(unset), CanNmMsgCycleOffset=(unset), CanNmMsgCycleTime=(unset), CanNmMsgReducedTime=(unset), CanNmRepeatMessageTime=(unset), CanNmTimeoutTime=(unset), CanNmWaitBusSleepTime=(unset), CanNmPduCbvPosition=(unset), CanNmPduNidPosition=(unset):
      CanNmChannelConfig
        6 x CanNmRxPdu, all with CanNmRxPduId=(unset):
          CanNmRxPdu
          CanNmRxPdu
          CanNmRxPdu
          CanNmRxPdu
          CanNmRxPdu
          CanNmRxPdu
      CanNmChannelConfig
        6 x CanNmRxPdu, all with CanNmRxPduId=(unset):
          CanNmRxPdu
          CanNmRxPdu
          CanNmRxPdu
          CanNmRxPdu
          CanNmRxPdu
          CanNmRxPdu
      CanNmChannelConfig
        6 x CanNmRxPdu, all with CanNmRxPduId=(unset):
          CanNmRxPdu
          CanNmRxPdu
          CanNmRxPdu
          CanNmRxPdu
          CanNmRxPdu
          CanNmRxPdu
      CanNmChannelConfig
        6 x CanNmRxPdu, all with CanNmRxPduId=(unset):
          CanNmRxPdu
          CanNmRxPdu
          CanNmRxPdu
          CanNmRxPdu
          CanNmRxPdu
          CanNmRxPdu
      CanNmChannelConfig
        6 x CanNmRxPdu, all with CanNmRxPduId=(unset):
          CanNmRxPdu
          CanNmRxPdu
          CanNmRxPdu
          CanNmRxPdu
          CanNmRxPdu
          CanNmRxPdu
      CanNmChannelConfig
        6 x CanNmRxPdu, all with CanNmRxPduId=(unset):
          CanNmRxPdu
          CanNmRxPdu
          CanNmRxPdu
          CanNmRxPdu
          CanNmRxPdu
          CanNmRxPdu
    CanNmGlobalConfig:
      CanNmBusLoadReductionEnabled = (unset)
      CanNmBusSynchronizationEnabled = (unset)
      CanNmComControlEnabled = (unset)
      CanNmComUserDataSupport = (unset)
      CanNmCoordinatorSyncSupport = (unset)
      CanNmDevErrorDetect = (unset)
      CanNmGlobalPnSupport = (unset)
      CanNmImmediateRestartEnabled = (unset)
      CanNmImmediateTxconfEnabled = (unset)
      CanNmPassiveModeEnabled = (unset)
      CanNmPduRxIndicationEnabled = (unset)
      CanNmRemoteSleepIndEnabled = (unset)
      CanNmStateChangeIndEnabled = (unset)
      CanNmUserDataEnabled = (unset)
      CanNmVersionInfoApi = (unset)
      CanNmMainFunctionPeriod = (unset)
    6 x CanNmChannelConfig, all with CanNmImmediateNmTransmissions=(unset), CanNmNodeId=(unset), CanNmBusLoadReductionActive=(unset), CanNmCarWakeUpRxEnabled=(unset), CanNmNodeDetectionEnabled=(unset), CanNmNodeIdEnabled=(unset), CanNmRepeatMsgIndEnabled=(unset), CanNmMsgCycleOffset=(unset), CanNmMsgCycleTime=(unset), CanNmMsgReducedTime=(unset), CanNmRepeatMessageTime=(unset), CanNmTimeoutTime=(unset), CanNmWaitBusSleepTime=(unset), CanNmPduCbvPosition=(unset), CanNmPduNidPosition=(unset):
      CanNmChannelConfig
        6 x CanNmRxPdu, all with CanNmRxPduId=(unset):
          CanNmRxPdu
          CanNmRxPdu
          CanNmRxPdu
          CanNmRxPdu
          CanNmRxPdu
          CanNmRxPdu
      CanNmChannelConfig
        6 x CanNmRxPdu, all with CanNmRxPduId=(unset):
          CanNmRxPdu
          CanNmRxPdu
          CanNmRxPdu
          CanNmRxPdu
          CanNmRxPdu
          CanNmRxPdu
      CanNmChannelConfig
        6 x CanNmRxPdu, all with CanNmRxPduId=(unset):
          CanNmRxPdu
          CanNmRxPdu
          CanNmRxPdu
          CanNmRxPdu
          CanNmRxPdu
          CanNmRxPdu
      CanNmChannelConfig
        6 x CanNmRxPdu, all with CanNmRxPduId=(unset):
          CanNmRxPdu
          CanNmRxPdu
          CanNmRxPdu
          CanNmRxPdu
          CanNmRxPdu
          CanNmRxPdu
      CanNmChannelConfig
        6 x CanNmRxPdu, all with CanNmRxPduId=(unset):
          CanNmRxPdu
          CanNmRxPdu
          CanNmRxPdu
          CanNmRxPdu
          CanNmRxPdu
          CanNmRxPdu
      CanNmChannelConfig
        6 x CanNmRxPdu, all with CanNmRxPduId=(unset):
          CanNmRxPdu
          CanNmRxPdu
          CanNmRxPdu
          CanNmRxPdu
          CanNmRxPdu
          CanNmRxPdu
    CanNmGlobalConfig:
      CanNmBusLoadReductionEnabled = (unset)
      CanNmBusSynchronizationEnabled = (unset)
      CanNmComControlEnabled = (unset)
      CanNmComUserDataSupport = (unset)
      CanNmCoordinatorSyncSupport = (unset)
      CanNmDevErrorDetect = (unset)
      CanNmGlobalPnSupport = (unset)
      CanNmImmediateRestartEnabled = (unset)
      CanNmImmediateTxconfEnabled = (unset)
      CanNmPassiveModeEnabled = (unset)
      CanNmPduRxIndicationEnabled = (unset)
      CanNmRemoteSleepIndEnabled = (unset)
      CanNmStateChangeIndEnabled = (unset)
      CanNmUserDataEnabled = (unset)
      CanNmVersionInfoApi = (unset)
      CanNmMainFunctionPeriod = (unset)
    6 x CanNmChannelConfig, all with CanNmImmediateNmTransmissions=(unset), CanNmNodeId=(unset), CanNmBusLoadReductionActive=(unset), CanNmCarWakeUpRxEnabled=(unset), CanNmNodeDetectionEnabled=(unset), CanNmNodeIdEnabled=(unset), CanNmRepeatMsgIndEnabled=(unset), CanNmMsgCycleOffset=(unset), CanNmMsgCycleTime=(unset), CanNmMsgReducedTime=(unset), CanNmRepeatMessageTime=(unset), CanNmTimeoutTime=(unset), CanNmWaitBusSleepTime=(unset), CanNmPduCbvPosition=(unset), CanNmPduNidPosition=(unset):
      CanNmChannelConfig
        6 x CanNmRxPdu, all with CanNmRxPduId=(unset):
          CanNmRxPdu
          CanNmRxPdu
          CanNmRxPdu
          CanNmRxPdu
          CanNmRxPdu
          CanNmRxPdu
      CanNmChannelConfig
        6 x CanNmRxPdu, all with CanNmRxPduId=(unset):
          CanNmRxPdu
          CanNmRxPdu
          CanNmRxPdu
          CanNmRxPdu
          CanNmRxPdu
          CanNmRxPdu
      CanNmChannelConfig
        6 x CanNmRxPdu, all with CanNmRxPduId=(unset):
          CanNmRxPdu
          CanNmRxPdu
          CanNmRxPdu
          CanNmRxPdu
          CanNmRxPdu
          CanNmRxPdu
      CanNmChannelConfig
        6 x CanNmRxPdu, all with CanNmRxPduId=(unset):
          CanNmRxPdu
          CanNmRxPdu
          CanNmRxPdu
          CanNmRxPdu
          CanNmRxPdu
          CanNmRxPdu
      CanNmChannelConfig
        6 x CanNmRxPdu, all with CanNmRxPduId=(unset):
          CanNmRxPdu
          CanNmRxPdu
          CanNmRxPdu
          CanNmRxPdu
          CanNmRxPdu
          CanNmRxPdu
      CanNmChannelConfig
        6 x CanNmRxPdu, all with CanNmRxPduId=(unset):
          CanNmRxPdu
          CanNmRxPdu
          CanNmRxPdu
          CanNmRxPdu
          CanNmRxPdu
          CanNmRxPdu
