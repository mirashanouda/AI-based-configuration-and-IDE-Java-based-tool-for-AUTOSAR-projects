AUTOSAR XML (schema 00046)
package /AutosarConfigurator
  module config CanNm: implementation-config-variant=VARIANT-POST-BUILD, module-description=CanNm
    CanNmGlobalConfig:
      CanNmBusLoadReductionEnabled = false
      CanNmBusSynchronizationEnabled = false
      CanNmComControlEnabled = false
      CanNmComUserDataSupport = false
      CanNmCoordinatorSyncSupport = false
      CanNmDevErrorDetect = false
      CanNmGlobalPnSupport = false
      CanNmImmediateRestartEnabled = false
      CanNmImmediateTxconfEnabled = false
      CanNmPassiveModeEnabled = false
      CanNmPduRxIndicationEnabled = false
      CanNmRemoteSleepIndEnabled = false
      CanNmStateChangeIndEnabled = false
      CanNmUserDataEnabled = false
      CanNmVersionInfoApi = false
      CanNmMainFunctionPeriod = 0.0
    CanNmChannelConfig:
      CanNmImmediateNmTransmissions = 0
      CanNmNodeId = 0
      CanNmBusLoadReductionActive = false
      CanNmCarWakeUpRxEnabled = false
      CanNmNodeDetectionEnabled = false
      CanNmNodeIdEnabled = false
      CanNmRepeatMsgIndEnabled = false
      CanNmMsgCycleOffset = 0.0
      CanNmMsgCycleTime = 0.0
      CanNmMsgReducedTime = 0.0
      CanNmRepeatMessageTime = 0.0
      CanNmTimeoutTime = 0.0
      CanNmWaitBusSleepTime = 0.0
      CanNmPduCbvPosition = CANNM_PDU_BYTE_0
      CanNmPduNidPosition = CANNM_PDU_BYTE_0
      CanNmRxPdu: CanNmRxPduId=0
