AUTOSAR XML (schema 00046)
package /AutosarConfigurator
  module config CanNm: implementation-config-variant=VARIANT-POST-BUILD, module-description=CanNm
    CanNmGlobalConfig:
      CanNmBusLoadReductionEnabled = False
      CanNmBusSynchronizationEnabled = False
      CanNmComControlEnabled = False
      CanNmComUserDataSupport = False
      CanNmCoordinatorSyncSupport = False
      CanNmDevErrorDetect = False
      CanNmGlobalPnSupport = False
      CanNmImmediateRestartEnabled = False
      CanNmImmediateTxconfEnabled = False
      CanNmPassiveModeEnabled = False
      CanNmPduRxIndicationEnabled = False
      CanNmRemoteSleepIndEnabled = False
      CanNmStateChangeIndEnabled = False
      CanNmUserDataEnabled = False
      CanNmVersionInfoApi = False
      CanNmMainFunctionPeriod = 0
      CanNmChannelConfig:
        CanNmPduCbvPosition = CANNM_PDU_BYTE_0
        CanNmPduNidPosition = CANNM_PDU_BYTE_0
        CanNmImmediateNmTransmissions = 0
        CanNmNodeId = 0
        CanNmBusLoadReductionActive = False
        CanNmCarWakeUpRxEnabled = False
        CanNmNodeDetectionEnabled = False
        CanNmNodeIdEnabled = False
        CanNmRepeatMsgIndEnabled = False
        CanNmMsgCycleOffset = 0
        CanNmMsgCycleTime = 0
        CanNmMsgReducedTime = 0
        CanNmRepeatMessageTime = 0
        CanNmTimeoutTime = 0
        CanNmWaitBusSleepTime = 0
        CanNmRxPdu: CanNmRxPduId=0
