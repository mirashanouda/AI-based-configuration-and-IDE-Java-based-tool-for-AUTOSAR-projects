AUTOSAR XML (schema 00046)
package /AutosarConfigurator
  module config CanNm: implementation-config-variant=VARIANT-POST-BUILD, module_description_ref=CanNm
    CanNmGlobalConfig:
      ecuc-numerical-param-value = {defintion=CanNmPnResetTime, value=7.517}
      ecuc-numerical-param-value = {defintion=CanNmBusSynchronizationEnabled, value=False}
      ecuc-numerical-param-value = {defintion=CanNmComControlEnabled, value=False}
      ecuc-numerical-param-value = {defintion=CanNmComUserDataSupport, value=False}
      ecuc-numerical-param-value = {defintion=CanNmCoordinatorSyncSupport, value=False}
      ecuc-numerical-param-value = {defintion=CanNmDevErrorDetect, value=False}
      ecuc-numerical-param-value = {defintion=CanNmImmediateRestartEnabled, value=False}
      ecuc-numerical-param-value = {defintion=CanNmPnEiraCalcEnabled, value=False}
      ecuc-numerical-param-value = {defintion=CanNmRemoteSleepIndEnabled, value=False}
      ecuc-numerical-param-value = {defintion=CanNmUserDataEnabled, value=False}
      4 x CanNmChannelConfig:
        CanNmChannelConfig: ecuc-numerical-param-value={defintion=CanNmMsgCycleOffset, value=48.956}, ecuc-numerical-param-value={defintion=CanNmMsgTimeoutTime, value=27.542}, ecuc-numerical-param-value={defintion=CanNmRemoteSleepIndTime, value=36.981}, ecuc-numerical-param-value={defintion=CanNmRepeatMessageTime, value=16.944}, ecuc-numerical-param-value={defintion=CanNmWaitBusSleepTime, value=48.138}, ecuc-numerical-param-value={defintion=CanNmActiveWakeupBitEnabled, value=False}, ecuc-numerical-param-value={defintion=CanNmCarWakeUpFilterEnabled, value=False}, ecuc-numerical-param-value={defintion=CanNmCarWakeUpRxEnabled, value=False}, ecuc-numerical-param-value={defintion=CanNmNodeIdEnabled, value=False}, ecuc-numerical-param-value={defintion=CanNmPnEnabled, value=False}, ecuc-numerical-param-value={defintion=CanNmPnHandleMultipleNetworkRequests, value=False}, ecuc-numerical-param-value={defintion=CanNmRepeatMsgIndEnabled, value=False}, ecuc-textual-param-value={defintion=CanNmPduCbvPosition, value=CANNM_PDU_BYTE_0}
          8 x CanNmRxPdu:
            CanNmRxPdu: ecuc-numerical-param-value={defintion=CanNmPnFilterMaskByteValue, value=171}
            CanNmRxPdu
            CanNmRxPdu
            CanNmRxPdu
            CanNmRxPdu
            CanNmRxPdu
            CanNmRxPdu
            CanNmRxPdu
          CanNmUserDataTxPdu
        CanNmChannelConfig
          5 x CanNmRxPdu:
            CanNmRxPdu
            CanNmRxPdu
            CanNmRxPdu
            CanNmRxPdu
            CanNmRxPdu
          CanNmTxPdu
        CanNmChannelConfig: ecuc-numerical-param-value={defintion=CanNmTxConfirmationPduId, value=63288}
          7 x CanNmRxPdu:
            CanNmRxPdu
            CanNmRxPdu
            CanNmRxPdu
            CanNmRxPdu
            CanNmRxPdu
            CanNmRxPdu
            CanNmRxPdu
          CanNmTxPdu
        CanNmChannelConfig: ecuc-numerical-param-value={defintion=CanNmTxUserDataPduId, value=47083}
          3 x CanNmRxPdu:
            CanNmRxPdu
            CanNmRxPdu
            CanNmRxPdu
          CanNmUserDataTxPdu
      CanNmPnInfo
        7 x CanNmPnFilterMaskByte:
          CanNmPnFilterMaskByte
          CanNmPnFilterMaskByte
          CanNmPnFilterMaskByte
          CanNmPnFilterMaskByte
          CanNmPnFilterMaskByte
          CanNmPnFilterMaskByte
          CanNmPnFilterMaskByte
