AUTOSAR XML (schema 00046)
package /AutosarConfigurator
  module config CanNm: implementation-config-variant=VARIANT-POST-BUILD, module_description_ref=CanNm
    CanNmGlobalConfig:
      ecuc-numerical-param-value = {defintion=CanNmMainFunctionPeriod, value=0}
      ecuc-numerical-param-value = {defintion=CanNmBusLoadReductionEnabled, value=False}
      ecuc-numerical-param-value = {defintion=CanNmBusSynchronizationEnabled, value=False}
      ecuc-numerical-param-value = {defintion=CanNmComControlEnabled, value=False}
      ecuc-numerical-param-value = {defintion=CanNmComUserDataSupport, value=False}
      ecuc-numerical-param-value = {defintion=CanNmCoordinatorSyncSupport, value=False}
      ecuc-numerical-param-value = {defintion=CanNmDevErrorDetect, value=False}
      ecuc-numerical-param-value = {defintion=CanNmGlobalPnSupport, value=False}
      ecuc-numerical-param-value = {defintion=CanNmImmediateRestartEnabled, value=False}
      ecuc-numerical-param-value = {defintion=CanNmImmediateTxconfEnabled, value=False}
      ecuc-numerical-param-value = {defintion=CanNmPassiveModeEnabled, value=False}
      ecuc-numerical-param-value = {defintion=CanNmPduRxIndicationEnabled, value=False}
      ecuc-numerical-param-value = {defintion=CanNmRemoteSleepIndEnabled, value=False}
      ecuc-numerical-param-value = {defintion=CanNmStateChangeIndEnabled, value=False}
      ecuc-numerical-param-value = {defintion=CanNmUserDataEnabled, value=False}
      ecuc-numerical-param-value = {defintion=CanNmVersionInfoApi, value=False}
      24 x CanNmChannelConfig, all with ecuc-numerical-param-value={defintion=CanNmMsgReducedTime, value=6.256}, ecuc-numerical-param-value={defintion=CanNmImmediateNmTransmissions, value=0}, ecuc-numerical-param-value={defintion=CanNmNodeId, value=0}, ecuc-numerical-param-value={defintion=CanNmMsgCycleOffset, value=0}, ecuc-numerical-param-value={defintion=CanNmMsgCycleTime, value=0}, ecuc-numerical-param-value={defintion=CanNmRepeatMessageTime, value=0}, ecuc-numerical-param-value={defintion=CanNmTimeoutTime, value=0}, ecuc-numerical-param-value={defintion=CanNmWaitBusSleepTime, value=0}, ecuc-numerical-param-value={defintion=CanNmBusLoadReductionActive, value=False}, ecuc-numerical-param-value={defintion=CanNmCarWakeUpRxEnabled, value=False}, ecuc-numerical-param-value={defintion=CanNmNodeDetectionEnabled, value=False}, ecuc-numerical-param-value={defintion=CanNmNodeIdEnabled, value=False}, ecuc-numerical-param-value={defintion=CanNmRepeatMsgIndEnabled, value=False}, ecuc-textual-param-value={defintion=CanNmPduCbvPosition, value=CANNM_PDU_BYTE_0}, ecuc-textual-param-value={defintion=CanNmPduNidPosition, value=CANNM_PDU_BYTE_0}:
        CanNmChannelConfig
          20 x CanNmRxPdu, all with ecuc-numerical-param-value={defintion=CanNmRxPduId, value=54079}:
            CanNmRxPdu
            CanNmRxPdu
            CanNmRxPdu
            CanNmRxPdu
            CanNmRxPdu
            CanNmRxPdu
            CanNmRxPdu
            CanNmRxPdu
            CanNmRxPdu
            CanNmRxPdu
            CanNmRxPdu
            CanNmRxPdu
            CanNmRxPdu
            CanNmRxPdu
            CanNmRxPdu
            CanNmRxPdu
            CanNmRxPdu
            CanNmRxPdu
            CanNmRxPdu
            CanNmRxPdu
        CanNmChannelConfig
          20 x CanNmRxPdu, all with ecuc-numerical-param-value={defintion=CanNmRxPduId, value=54079}:
            CanNmRxPdu
            CanNmRxPdu
            CanNmRxPdu
            CanNmRxPdu
            CanNmRxPdu
            CanNmRxPdu
            CanNmRxPdu
            CanNmRxPdu
            CanNmRxPdu
            CanNmRxPdu
            CanNmRxPdu
            CanNmRxPdu
            CanNmRxPdu
            CanNmRxPdu
            CanNmRxPdu
            CanNmRxPdu
            CanNmRxPdu
            CanNmRxPdu
            CanNmRxPdu
            CanNmRxPdu
        CanNmChannelConfig
          20 x CanNmRxPdu, all with ecuc-numerical-param-value={defintion=CanNmRxPduId, value=54079}:
            CanNmRxPdu
            CanNmRxPdu
            CanNmRxPdu
            CanNmRxPdu
            CanNmRxPdu
            CanNmRxPdu
            CanNmRxPdu
            CanNmRxPdu
            CanNmRxPdu
            CanNmRxPdu
            CanNmRxPdu
            CanNmRxPdu
            CanNmRxPdu
            CanNmRxPdu
            CanNmRxPdu
            CanNmRxPdu
            CanNmRxPdu
            CanNmRxPdu
            CanNmRxPdu
            CanNmRxPdu
        CanNmChannelConfig
          20 x CanNmRxPdu, all with ecuc-numerical-param-value={defintion=CanNmRxPduId, value=54079}:
            CanNmRxPdu
            CanNmRxPdu
            CanNmRxPdu
            CanNmRxPdu
            CanNmRxPdu
            CanNmRxPdu
            CanNmRxPdu
            CanNmRxPdu
            CanNmRxPdu
            CanNmRxPdu
            CanNmRxPdu
            CanNmRxPdu
            CanNmRxPdu
            CanNmRxPdu
            CanNmRxPdu
            CanNmRxPdu
            CanNmRxPdu
            CanNmRxPdu
            CanNmRxPdu
            CanNmRxPdu
        CanNmChannelConfig
          20 x CanNmRxPdu, all with ecuc-numerical-param-value={defintion=CanNmRxPduId, value=54079}:
            CanNmRxPdu
            CanNmRxPdu
            CanNmRxPdu
            CanNmRxPdu
            CanNmRxPdu
            CanNmRxPdu
            CanNmRxPdu
            CanNmRxPdu
            CanNmRxPdu
            CanNmRxPdu
            CanNmRxPdu
            CanNmRxPdu
            CanNmRxPdu
            CanNmRxPdu
            CanNmRxPdu
            CanNmRxPdu
            CanNmRxPdu
            CanNmRxPdu
            CanNmRxPdu
            CanNmRxPdu
        CanNmChannelConfig
          20 x CanNmRxPdu, all with ecuc-numerical-param-value={defintion=CanNmRxPduId, value=54079}:
            CanNmRxPdu
            CanNmRxPdu
            CanNmRxPdu
            CanNmRxPdu
            CanNmRxPdu
            CanNmRxPdu
            CanNmRxPdu
            CanNmRxPdu
            CanNmRxPdu
            CanNmRxPdu
            CanNmRxPdu
            CanNmRxPdu
            CanNmRxPdu
            CanNmRxPdu
            CanNmRxPdu
            CanNmRxPdu
            CanNmRxPdu
            CanNmRxPdu
            CanNmRxPdu
            CanNmRxPdu
        CanNmChannelConfig
          20 x CanNmRxPdu, all with ecuc-numerical-param-value={defintion=CanNmRxPduId, value=54079}:
            CanNmRxPdu
            CanNmRxPdu
            CanNmRxPdu
            CanNmRxPdu
            CanNmRxPdu
            CanNmRxPdu
            CanNmRxPdu
            CanNmRxPdu
            CanNmRxPdu
            CanNmRxPdu
            CanNmRxPdu
            CanNmRxPdu
            CanNmRxPdu
            CanNmRxPdu
            CanNmRxPdu
            CanNmRxPdu
            CanNmRxPdu
            CanNmRxPdu
            CanNmRxPdu
            CanNmRxPdu
        CanNmChannelConfig
          20 x CanNmRxPdu, all with ecuc-numerical-param-value={defintion=CanNmRxPduId, value=54079}:
            CanNmRxPdu
            CanNmRxPdu
            CanNmRxPdu
            CanNmRxPdu
            CanNmRxPdu
            CanNmRxPdu
            CanNmRxPdu
            CanNmRxPdu
            CanNmRxPdu
            CanNmRxPdu
            CanNmRxPdu
            CanNmRxPdu
            CanNmRxPdu
            CanNmRxPdu
            CanNmRxPdu
            CanNmRxPdu
            CanNmRxPdu
            CanNmRxPdu
            CanNmRxPdu
            CanNmRxPdu
        CanNmChannelConfig
          20 x CanNmRxPdu, all with ecuc-numerical-param-value={defintion=CanNmRxPduId, value=54079}:
            CanNmRxPdu
            CanNmRxPdu
            CanNmRxPdu
            CanNmRxPdu
            CanNmRxPdu
            CanNmRxPdu
            CanNmRxPdu
            CanNmRxPdu
            CanNmRxPdu
            CanNmRxPdu
            CanNmRxPdu
            CanNmRxPdu
            CanNmRxPdu
            CanNmRxPdu
            CanNmRxPdu
            CanNmRxPdu
            CanNmRxPdu
            CanNmRxPdu
            CanNmRxPdu
            CanNmRxPdu
        CanNmChannelConfig
          20 x CanNmRxPdu, all with ecuc-numerical-param-value={defintion=CanNmRxPduId, value=54079}:
            CanNmRxPdu
            CanNmRxPdu
            CanNmRxPdu
            CanNmRxPdu
            CanNmRxPdu
            CanNmRxPdu
            CanNmRxPdu
            CanNmRxPdu
            CanNmRxPdu
            CanNmRxPdu
            CanNmRxPdu
            CanNmRxPdu
            CanNmRxPdu
            CanNmRxPdu
            CanNmRxPdu
            CanNmRxPdu
            CanNmRxPdu
            CanNmRxPdu
            CanNmRxPdu
            CanNmRxPdu
        CanNmChannelConfig
          20 x CanNmRxPdu, all with ecuc-numerical-param-value={defintion=CanNmRxPduId, value=54079}:
            CanNmRxPdu
            CanNmRxPdu
            CanNmRxPdu
            CanNmRxPdu
            CanNmRxPdu
            CanNmRxPdu
            CanNmRxPdu
            CanNmRxPdu
            CanNmRxPdu
            CanNmRxPdu
            CanNmRxPdu
            CanNmRxPdu
            CanNmRxPdu
            CanNmRxPdu
            CanNmRxPdu
            CanNmRxPdu
            CanNmRxPdu
            CanNmRxPdu
            CanNmRxPdu
            CanNmRxPdu
        CanNmChannelConfig
          20 x CanNmRxPdu, all with ecuc-numerical-param-value={defintion=CanNmRxPduId, value=54079}:
            CanNmRxPdu
            CanNmRxPdu
            CanNmRxPdu
            CanNmRxPdu
            CanNmRxPdu
            CanNmRxPdu
            CanNmRxPdu
            CanNmRxPdu
            CanNmRxPdu
            CanNmRxPdu
            CanNmRxPdu
            CanNmRxPdu
            CanNmRxPdu
            CanNmRxPdu
            CanNmRxPdu
            CanNmRxPdu
            CanNmRxPdu
            CanNmRxPdu
            CanNmRxPdu
            CanNmRxPdu
        CanNmChannelConfig
          20 x CanNmRxPdu, all with ecuc-numerical-param-value={defintion=CanNmRxPduId, value=54079}:
            CanNmRxPdu
            CanNmRxPdu
            CanNmRxPdu
            CanNmRxPdu
            CanNmRxPdu
            CanNmRxPdu
            CanNmRxPdu
            CanNmRxPdu
            CanNmRxPdu
            CanNmRxPdu
            CanNmRxPdu
            CanNmRxPdu
            CanNmRxPdu
            CanNmRxPdu
            CanNmRxPdu
            CanNmRxPdu
            CanNmRxPdu
            CanNmRxPdu
            CanNmRxPdu
            CanNmRxPdu
        CanNmChannelConfig
          20 x CanNmRxPdu, all with ecuc-numerical-param-value={defintion=CanNmRxPduId, value=54079}:
            CanNmRxPdu
            CanNmRxPdu
            CanNmRxPdu
            CanNmRxPdu
            CanNmRxPdu
            CanNmRxPdu
            CanNmRxPdu
            CanNmRxPdu
            CanNmRxPdu
            CanNmRxPdu
            CanNmRxPdu
            CanNmRxPdu
            CanNmRxPdu
            CanNmRxPdu
            CanNmRxPdu
            CanNmRxPdu
            CanNmRxPdu
            CanNmRxPdu
            CanNmRxPdu
            CanNmRxPdu
        CanNmChannelConfig
          20 x CanNmRxPdu, all with ecuc-numerical-param-value={defintion=CanNmRxPduId, value=54079}:
            CanNmRxPdu
            CanNmRxPdu
            CanNmRxPdu
            CanNmRxPdu
            CanNmRxPdu
            CanNmRxPdu
            CanNmRxPdu
            CanNmRxPdu
            CanNmRxPdu
            CanNmRxPdu
            CanNmRxPdu
            CanNmRxPdu
            CanNmRxPdu
            CanNmRxPdu
            CanNmRxPdu
            CanNmRxPdu
            CanNmRxPdu
            CanNmRxPdu
            CanNmRxPdu
            CanNmRxPdu
        CanNmChannelConfig
          20 x CanNmRxPdu, all with ecuc-numerical-param-value={defintion=CanNmRxPduId, value=54079}:
            CanNmRxPdu
            CanNmRxPdu
            CanNmRxPdu
            CanNmRxPdu
            CanNmRxPdu
            CanNmRxPdu
            CanNmRxPdu
            CanNmRxPdu
            CanNmRxPdu
            CanNmRxPdu
            CanNmRxPdu
            CanNmRxPdu
            CanNmRxPdu
            CanNmRxPdu
            CanNmRxPdu
            CanNmRxPdu
            CanNmRxPdu
            CanNmRxPdu
            CanNmRxPdu
            CanNmRxPdu
        CanNmChannelConfig
          20 x CanNmRxPdu, all with ecuc-numerical-param-value={defintion=CanNmRxPduId, value=54079}:
            CanNmRxPdu
            CanNmRxPdu
            CanNmRxPdu
            CanNmRxPdu
            CanNmRxPdu
            CanNmRxPdu
            CanNmRxPdu
            CanNmRxPdu
            CanNmRxPdu
            CanNmRxPdu
            CanNmRxPdu
            CanNmRxPdu
            CanNmRxPdu
            CanNmRxPdu
            CanNmRxPdu
            CanNmRxPdu
            CanNmRxPdu
            CanNmRxPdu
            CanNmRxPdu
            CanNmRxPdu
        CanNmChannelConfig
          20 x CanNmRxPdu, all with ecuc-numerical-param-value={defintion=CanNmRxPduId, value=54079}:
            CanNmRxPdu
            CanNmRxPdu
            CanNmRxPdu
            CanNmRxPdu
            CanNmRxPdu
            CanNmRxPdu
            CanNmRxPdu
            CanNmRxPdu
            CanNmRxPdu
            CanNmRxPdu
            CanNmRxPdu
            CanNmRxPdu
            CanNmRxPdu
            CanNmRxPdu
            CanNmRxPdu
            CanNmRxPdu
            CanNmRxPdu
            CanNmRxPdu
            CanNmRxPdu
            CanNmRxPdu
        CanNmChannelConfig
          20 x CanNmRxPdu, all with ecuc-numerical-param-value={defintion=CanNmRxPduId, value=54079}:
            CanNmRxPdu
            CanNmRxPdu
            CanNmRxPdu
            CanNmRxPdu
            CanNmRxPdu
            CanNmRxPdu
            CanNmRxPdu
            CanNmRxPdu
            CanNmRxPdu
            CanNmRxPdu
            CanNmRxPdu
            CanNmRxPdu
            CanNmRxPdu
            CanNmRxPdu
            CanNmRxPdu
            CanNmRxPdu
            CanNmRxPdu
            CanNmRxPdu
            CanNmRxPdu
            CanNmRxPdu
        CanNmChannelConfig
          20 x CanNmRxPdu, all with ecuc-numerical-param-value={defintion=CanNmRxPduId, value=54079}:
            CanNmRxPdu
            CanNmRxPdu
            CanNmRxPdu
            CanNmRxPdu
            CanNmRxPdu
            CanNmRxPdu
            CanNmRxPdu
            CanNmRxPdu
            CanNmRxPdu
            CanNmRxPdu
            CanNmRxPdu
            CanNmRxPdu
            CanNmRxPdu
            CanNmRxPdu
            CanNmRxPdu
            CanNmRxPdu
            CanNmRxPdu
            CanNmRxPdu
            CanNmRxPdu
            CanNmRxPdu
        CanNmChannelConfig
          20 x CanNmRxPdu, all with ecuc-numerical-param-value={defintion=CanNmRxPduId, value=54079}:
            CanNmRxPdu
            CanNmRxPdu
            CanNmRxPdu
            CanNmRxPdu
            CanNmRxPdu
            CanNmRxPdu
            CanNmRxPdu
            CanNmRxPdu
            CanNmRxPdu
            CanNmRxPdu
            CanNmRxPdu
            CanNmRxPdu
            CanNmRxPdu
            CanNmRxPdu
            CanNmRxPdu
            CanNmRxPdu
            CanNmRxPdu
            CanNmRxPdu
            CanNmRxPdu
            CanNmRxPdu
        CanNmChannelConfig
          20 x CanNmRxPdu, all with ecuc-numerical-param-value={defintion=CanNmRxPduId, value=54079}:
            CanNmRxPdu
            CanNmRxPdu
            CanNmRxPdu
            CanNmRxPdu
            CanNmRxPdu
            CanNmRxPdu
            CanNmRxPdu
            CanNmRxPdu
            CanNmRxPdu
            CanNmRxPdu
            CanNmRxPdu
            CanNmRxPdu
            CanNmRxPdu
            CanNmRxPdu
            CanNmRxPdu
            CanNmRxPdu
            CanNmRxPdu
            CanNmRxPdu
            CanNmRxPdu
            CanNmRxPdu
        CanNmChannelConfig
          20 x CanNmRxPdu, all with ecuc-numerical-param-value={defintion=CanNmRxPduId, value=54079}:
            CanNmRxPdu
            CanNmRxPdu
            CanNmRxPdu
            CanNmRxPdu
            CanNmRxPdu
            CanNmRxPdu
            CanNmRxPdu
            CanNmRxPdu
            CanNmRxPdu
            CanNmRxPdu
            CanNmRxPdu
            CanNmRxPdu
            CanNmRxPdu
            CanNmRxPdu
            CanNmRxPdu
            CanNmRxPdu
            CanNmRxPdu
            CanNmRxPdu
            CanNmRxPdu
            CanNmRxPdu
        CanNmChannelConfig
          20 x CanNmRxPdu, all with ecuc-numerical-param-value={defintion=CanNmRxPduId, value=54079}:
            CanNmRxPdu
            CanNmRxPdu
            CanNmRxPdu
            CanNmRxPdu
            CanNmRxPdu
            CanNmRxPdu
            CanNmRxPdu
            CanNmRxPdu
            CanNmRxPdu
            CanNmRxPdu
            CanNmRxPdu
            CanNmRxPdu
            CanNmRxPdu
            CanNmRxPdu
            CanNmRxPdu
            CanNmRxPdu
            CanNmRxPdu
            CanNmRxPdu
            CanNmRxPdu
            CanNmRxPdu
